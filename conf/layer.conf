## conf/layer.conf
```bitbake
# We have a conf and classes directory, add to BBPATH
BBPATH .= ":${LAYERDIR}"

# We have a recipes-* directories, add to BBFILES
BBFILES += "${LAYERDIR}/recipes-*/*/*.bb \
	${LAYERDIR}/recipes-*/*/*.bbappend"

BBFILE_COLLECTIONS += "jz"
BBFILE_PATTERN_jz = "^${LAYERDIR}/"
BBFILE_PRIORITY_jz = "6"
```

## conf/machine/ci20.conf
```bitbake
#@TYPE: Machine
#@NAME: ci20
#@DESCRIPTION: Machine configuration for ci20 systems

require conf/machine/include/tune-mips32r2.inc
include conf/machine/include/default-settings.inc

DEFAULTTUNE = "mips32r2el"

MACHINE_FEATURES = "screen keyboard usbhost ext2 ext3 serial"
MACHINE_FIRMWARE += "linux-firmware-bcm4329"
EXTRA_IMAGEDEPENDS += "u-boot-ci20"
UBOOT_MACHINE = "ci20_mmc"

KERNEL_IMAGETYPE = "uImage"

PREFERRED_PROVIDER_virtual/kernel ?= "linux-ci20"
PREFERRED_VERSION_linux-ci20 ?= "3.18%"
PREFERRED_VERSION_u-boot="u-boot-ci20_2013.10"

#VIRTUAL-RUNTIME_graphical_init_manager = "lxdm"
#IMAGE_INSTALL += "lxdm mousepad gigolo orage ristretto xarchiver xfce4-mixer xfce4-notifyd xfce4-screenshooter xfce4-taskmanager xfce4-terminal"
#PACKAGE_EXCLUDE = "gdm"

#PREFERRED_PROVIDER_virtual/xserver ?= "xserver-xorg"
#XSERVER ?= "xserver-xorg 
#xf86-input-evdev 
#xf86-video-fbdev"

SERIAL_CONSOLE = "115200;ttyS0 115200;ttyS4"
#USE_VT ?= "0"

MACHINE_ESSENTIAL_EXTRA_RDEPENDS = "kernel kernel-modules"

IMAGE_FSTYPES ?= "tar.bz2 ext4 sdcard"

# do ubiattach /dev/ubi_ctrl -m 7 -O 2048
# From dmesg:
# UBI: smallest flash I/O unit:    8192 
# UBI: logical eraseblock size:    2080768 bytes
# from ubiattach stdout:
# UBI device number 0, total 1988 LEBs
#MKUBIFS_ARGS = "-F -m 8192 -e 2080768 -c 4196"

# do ubiattach /dev/ubi_ctrl -m 7 -O 2048
# from dmesg:
# UBI: smallest flash I/O unit:    8192 
# UBI: physical eraseblock size:   2097152 bytes (2048 KiB)
# UBI: sub-page size:              16384 
# UBI: VID header offset:          8192 (aligned 8192)
#UBINIZE_ARGS = "-m 8192 -p 2048 KiB -s 512 -O 8192"

#EXTRA_IMAGEDEPENDS += "u-boot"
#UBOOT_MACHINE_ci20_mmc = "ci20_mmc"
#PREFERRED_VERSION_u-boot ?= "ci20-v2013.10"
#UBOOT_ENTRYPOINT = "0x80010000"
#UBOOT_LOADADDRESS = "${UBOOT_ENTRYPOINT}"

SDCARD_ROOTFS ?= "${DEPLOY_DIR_IMAGE}/${IMAGE_NAME}.rootfs.ext4"
```
